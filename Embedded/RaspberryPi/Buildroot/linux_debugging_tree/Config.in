## Embedded/RaspberryPi/Buildroot/linux_debugging_tree/Config.in
```kconfig
# linux_debugging_tree/Config.in
menu "Linux Debugging Tree"

    config BR2_LINUX_DEBUGGING_TREE
        bool "Linux Debugging Tree modules"
        help
          This is a collection of various kernel modules for debugging purposes.
          You can enable and build one or more kernel modules here.


    source "$BR2_EXTERNAL_LINUX_DEBUGGING_TREE_PATH/package/pr_dev_demo/Config.in"
    source "$BR2_EXTERNAL_LINUX_DEBUGGING_TREE_PATH/package/log_demo/Config.in"
    source "$BR2_EXTERNAL_LINUX_DEBUGGING_TREE_PATH/package/dev_log_demo/Config.in"

endmenu
```

## Embedded/RaspberryPi/Buildroot/linux_debugging_tree/package/log_demo/Config.in
```kconfig
config BR2_PACKAGE_LOG_DEMO
    bool "log_demo kernel module"
    depends on BR2_LINUX_KERNEL
    help
      A kernel module that logs various kernel events.
```

## Embedded/RaspberryPi/Buildroot/linux_debugging_tree/package/pr_dev_demo/Config.in
```kconfig
config BR2_PACKAGE_PR_DEV_DEMO
    bool "pr_format_demo kernel module"
    depends on BR2_LINUX_KERNEL
    help
      A kernel module that demonstrates printk format specifiers.
```
